## external/Config.in
```kconfig
source "$BR2_EXTERNAL_NETRADAR_PATH/package/test-generic-pkg/Config.in"
source "$BR2_EXTERNAL_NETRADAR_PATH/package/test-cmake-pkg/Config.in"
```

## external/configs/netradar_defconfig
```kconfig
BR2_x86_64=y
BR2_TOOLCHAIN_EXTERNAL=y
BR2_DL_DIR="$(TOPDIR)/buildroot-dl"
# BR2_TARGET_ROOTFS_TAR is not set
BR2_PACKAGE_TESTPKG=y
BR2_PACKAGE_TEST_CMAKE_PKG=y
```

## external/package/test-cmake-pkg/Config.in
```kconfig
config BR2_PACKAGE_TEST_CMAKE_PKG
	bool "test cmake package"
	help
	  A cmake package to do experiments on
```

## external/package/test-generic-pkg/Config.in
```kconfig
config BR2_PACKAGE_TEST_GENERIC_PKG
	bool "test  generic package"
	help
	  A generic package to do experiments on
```

## external/package/testpkg/Config.in
```kconfig
config BR2_PACKAGE_TESTPKG
	bool "test package"
	help
	  A test package to do experiments on
```
